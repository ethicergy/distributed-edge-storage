#include <Arduino.h>

#include <cstddef>
#include <cstdint>
#include <cstdio>
#include <cstring>

#include "dedup_manager.h"
#include "hlc.h"
#include "kv_engine.h"
#include "kv_response.h"
#include "membership.h"
#include "node_id.h"
#include "placement.h"
#include "protocol.h"
#include "reliable_packet.h"
#include "request_identity.h"
#include "request_manager.h"
#include "storage.h"
#include "transport.h"

namespace {

#ifndef NODE_ID
#error "NODE_ID must be defined by PlatformIO"
#endif

constexpr node::Id LOCAL_NODE_ID =
    static_cast<node::Id>(NODE_ID);

constexpr node::Id TEST_PEER_NODE_ID =
    LOCAL_NODE_ID == node::A
        ? node::C
        : node::A;

constexpr std::uint64_t MEMBERSHIP_TIMEOUT_MS = 10000;
constexpr std::uint64_t CLIENT_START_DELAY_MS = 2000;

hlc::Clock hlc_clock(
    []() -> std::uint64_t {
        return static_cast<std::uint64_t>(millis());
    }
);

storage::StorageManager storage_manager;

membership::Manager membership_manager(
    LOCAL_NODE_ID,
    MEMBERSHIP_TIMEOUT_MS
);

placement::Resolver placement_resolver;

kv::Engine kv_engine(
    LOCAL_NODE_ID,
    storage_manager,
    placement_resolver
);

transport::EspNowTransport espnow_transport;

request::TimingConfig request_timing{};

request::Manager request_manager(
    request_timing
);

request::DedupManager dedup_manager;

request::Generator request_id_generator;

struct RequestSenderContext {
    transport::EspNowTransport* transport;
};

RequestSenderContext sender_context{
    &espnow_transport
};

enum class ClientOperation : std::uint8_t {
    SET_WITH_RETRY = 0,
    GET_EXPECT_VALUE,
    DELETE_EXPECT_OK,
    GET_EXPECT_NOT_FOUND
};

constexpr std::uint8_t TEST_VALUE[] = {
    'd', 'i', 's', 't', 'r', 'i', 'b', 'u', 't', 'e', 'd'
};

bool system_ready = false;

bool request_started = false;
bool request_finished = false;
bool client_test_done = false;

ClientOperation active_operation =
    ClientOperation::SET_WITH_RETRY;

request::Identity active_request{};

std::uint8_t active_packet[
    protocol::MAX_PACKET_SIZE
]{};

std::size_t active_packet_length = 0;

std::uint8_t test_key[
    storage::KEY_MAX
]{};

std::size_t test_key_length = 0;

std::uint32_t receiver_set_execution_count = 0;



/*
 * This intentionally drops the first SET_ACK generated by
 * the receiver.
 *
 * Expected sequence:
 *
 *     B -> A : SET_REQ
 *     A       : execute exactly once
 *     A       : cache SET_ACK
 *     A       : drop first SET_ACK
 *     B       : timeout
 *     B -> A : RETRY SET_REQ
 *     A       : DEDUP DUPLICATE_COMPLETED
 *     A -> B : cached SET_ACK
 *     B       : request completes
 */
bool drop_first_set_ack = true;

std::uint64_t client_start_time_ms = 0;

bool build_set_request(
    request::Identity identity,
    const std::uint8_t* key,
    std::size_t key_length,
    const std::uint8_t* value,
    std::size_t value_length,
    std::uint8_t* output,
    std::size_t output_capacity,
    std::size_t& output_length
)
{
    if (
        key == nullptr ||
        value == nullptr ||
        output == nullptr
    ) {
        return false;
    }

    if (key_length == 0 ||
        key_length > storage::KEY_MAX) {
        return false;
    }

    if (value_length > storage::VALUE_MAX) {
        return false;
    }

    protocol::SetRequestPayload payload{
        protocol::KeyView{
            key,
            static_cast<std::uint8_t>(key_length)
        },
        protocol::ValueView{
            value,
            static_cast<std::uint8_t>(value_length)
        }
    };

    std::uint8_t payload_buffer[
        protocol::MAX_PAYLOAD_SIZE
    ]{};

    std::size_t payload_length = 0;

    if (
        protocol::serialize_set_request(
            payload,
            payload_buffer,
            sizeof(payload_buffer),
            payload_length
        ) != protocol::Result::OK
    ) {
        return false;
    }

    const std::uint64_t mutation_hlc =
        hlc_clock.on_local_event();

    const protocol::PacketHeader header{
        protocol::PROTOCOL_VERSION,
        protocol::MessageType::SET_REQ,
        0,
        protocol::HEADER_SIZE,

        identity.request_id,

        identity.origin,
        LOCAL_NODE_ID,
        TEST_PEER_NODE_ID,

        0,

        mutation_hlc,

        static_cast<std::uint16_t>(
            payload_length
        )
    };

    return
        protocol::serialize_packet(
            header,
            protocol::ByteView{
    payload_buffer,
    static_cast<std::uint8_t>(payload_length)
},
            output,
            output_capacity,
            output_length
        ) == protocol::Result::OK;
}
bool build_key_only_request(
    request::Identity identity,
    protocol::MessageType message_type,
    const std::uint8_t* key,
    std::size_t key_length,
    std::uint8_t* output,
    std::size_t output_capacity,
    std::size_t& output_length
)
{
    output_length = 0;

    if (
        !identity.valid() ||
        key == nullptr ||
        output == nullptr ||
        key_length == 0 ||
        key_length > storage::KEY_MAX
    ) {
        return false;
    }

    const protocol::KeyView key_view{
        key,
        static_cast<std::uint8_t>(key_length)
    };

    std::uint8_t payload_buffer[
        protocol::MAX_PAYLOAD_SIZE
    ]{};

    std::size_t payload_length = 0;

    protocol::Result payload_result =
        protocol::Result::INVALID_MESSAGE;

    if (
        message_type ==
        protocol::MessageType::GET_REQ
    ) {
        const protocol::GetRequestPayload payload{
            key_view
        };

        payload_result =
            protocol::serialize_get_request(
                payload,
                payload_buffer,
                sizeof(payload_buffer),
                payload_length
            );
    } else if (
        message_type ==
        protocol::MessageType::DEL_REQ
    ) {
        const protocol::DeleteRequestPayload payload{
            key_view
        };

        payload_result =
            protocol::serialize_delete_request(
                payload,
                payload_buffer,
                sizeof(payload_buffer),
                payload_length
            );
    } else {
        return false;
    }

    if (payload_result != protocol::Result::OK) {
        return false;
    }

    const std::uint64_t request_hlc =
        hlc_clock.on_local_event();

    if (request_hlc == 0) {
        return false;
    }

    const protocol::PacketHeader header{
        protocol::PROTOCOL_VERSION,
        message_type,
        0,
        protocol::HEADER_SIZE,

        identity.request_id,

        identity.origin,
        LOCAL_NODE_ID,
        TEST_PEER_NODE_ID,

        0,

        request_hlc,

        static_cast<std::uint16_t>(
            payload_length
        )
    };

    return
        protocol::serialize_packet(
            header,
            protocol::ByteView{
    payload_buffer,
    static_cast<std::uint8_t>(payload_length)
},
            output,
            output_capacity,
            output_length
        ) == protocol::Result::OK;
}

bool reliable_send(
    void* context,
    node::Id destination,
    const std::uint8_t* packet,
    std::size_t packet_length,
    bool retry
)
{
    auto* sender =
        static_cast<RequestSenderContext*>(
            context
        );

    if (
        sender == nullptr ||
        sender->transport == nullptr ||
        packet == nullptr
    ) {
        return false;
    }

    if (
        destination < node::MIN ||
        destination > node::MAX
    ) {
        return false;
    }

    if (!retry) {

        return
            sender->transport->send_unicast(
                destination,
                packet,
                packet_length
            ) == transport::Result::OK;
    }

    std::uint8_t retry_packet[
        protocol::MAX_PACKET_SIZE
    ]{};

    std::size_t retry_length = 0;

    if (
        request::prepare_retry(
            packet,
            packet_length,
            retry_packet,
            sizeof(retry_packet),
            retry_length
        ) != request::PacketResult::OK
    ) {
        return false;
    }

    Serial.print("RETRY SEND -> NODE ");
    Serial.println(
        static_cast<unsigned>(destination)
    );

    return
        sender->transport->send_unicast(
            destination,
            retry_packet,
            retry_length
        ) == transport::Result::OK;
}

bool find_key_owned_by_node(
    node::Id desired_primary
)
{
    /*
     * The test uses only A and C as live nodes.
     * This gives both boards the same routing view.
     */

    const std::uint32_t boot_tag = esp_random();

    for (unsigned index = 0; index < 1000; ++index) {

        const int written = std::snprintf(
            reinterpret_cast<char*>(test_key),
            sizeof(test_key),
            "phase6_wire_%lu_%03u",
            static_cast<unsigned long>(boot_tag),
            index
        );

        if (written <= 0) {
            continue;
        }

        const std::size_t length =
            static_cast<std::size_t>(written);

        if (length > storage::KEY_MAX) {
            continue;
        }

        placement::Assignment assignment{};

        if (
            !placement_resolver.locate(
                test_key,
                length,
                membership_manager,
                static_cast<std::uint64_t>(millis()),
                assignment
            )
        ) {
            continue;
        }

        if (assignment.primary != desired_primary) {
            continue;
        }

        test_key_length = length;

        Serial.print("TEST KEY: ");

        for (std::size_t i = 0; i < test_key_length; ++i) {
            Serial.write(test_key[i]);
        }

        Serial.println();

        Serial.print("PRIMARY: ");
        Serial.println(
            static_cast<unsigned>(assignment.primary)
        );

        Serial.print("REPLICA: ");
        Serial.println(
            static_cast<unsigned>(assignment.replica)
        );

        return true;
    }

    return false;
}
bool start_client_operation(
    ClientOperation operation
)
{
    active_operation = operation;
    request_finished = false;

    active_request = request_id_generator.next();

    if (!active_request.valid()) {
        Serial.println(
            "REQUEST ID GENERATION: FAIL"
        );

        client_test_done = true;
        return false;
    }

    bool built = false;

    switch (operation) {
        case ClientOperation::SET_WITH_RETRY:
            built = build_set_request(
                active_request,
                test_key,
                test_key_length,
                TEST_VALUE,
                sizeof(TEST_VALUE),
                active_packet,
                sizeof(active_packet),
                active_packet_length
            );
            break;

        case ClientOperation::GET_EXPECT_VALUE:
        case ClientOperation::GET_EXPECT_NOT_FOUND:
            built = build_key_only_request(
                active_request,
                protocol::MessageType::GET_REQ,
                test_key,
                test_key_length,
                active_packet,
                sizeof(active_packet),
                active_packet_length
            );
            break;

        case ClientOperation::DELETE_EXPECT_OK:
            built = build_key_only_request(
                active_request,
                protocol::MessageType::DEL_REQ,
                test_key,
                test_key_length,
                active_packet,
                sizeof(active_packet),
                active_packet_length
            );
            break;
    }

    if (!built) {
        Serial.println(
            "CLIENT REQUEST BUILD: FAIL"
        );

        client_test_done = true;
        return false;
    }

    bool initial_send_ok = false;

    const request::Result submit_result =
        request_manager.submit(
            active_request,
            node::A,
            active_packet,
            active_packet_length,
            static_cast<std::uint64_t>(millis()),
            reliable_send,
            &sender_context,
            initial_send_ok
        );

    if (submit_result != request::Result::OK) {
        Serial.print("REQUEST SUBMIT: FAIL (");
        Serial.print(
            static_cast<unsigned>(submit_result)
        );
        Serial.println(")");

        client_test_done = true;
        return false;
    }

    Serial.println();

    switch (operation) {
        case ClientOperation::SET_WITH_RETRY:
            Serial.println(
                "CLIENT: SET_REQ SUBMITTED"
            );
            break;

        case ClientOperation::GET_EXPECT_VALUE:
            Serial.println(
                "CLIENT: GET_REQ (VALUE CHECK) SUBMITTED"
            );
            break;

        case ClientOperation::DELETE_EXPECT_OK:
            Serial.println(
                "CLIENT: DEL_REQ SUBMITTED"
            );
            break;

        case ClientOperation::GET_EXPECT_NOT_FOUND:
            Serial.println(
                "CLIENT: GET_REQ (NOT FOUND CHECK) SUBMITTED"
            );
            break;
    }

    Serial.print("REQUEST ID: ");
    Serial.println(active_request.request_id);

    Serial.print("INITIAL SEND: ");
    Serial.println(
        initial_send_ok
            ? "OK"
            : "TRANSPORT FAILURE"
    );

    return true;
}
void process_server_request(
    const transport::ReceivedFrame& frame
)
{
    protocol::PacketView packet{};

    if (
        protocol::deserialize_packet(
            frame.data,
            frame.length,
            packet
        ) != protocol::Result::OK
    ) {
        Serial.println(
            "RX PACKET DECODE: FAIL"
        );
        return;
    }

    if (
        packet.header.destination_node_id !=
        LOCAL_NODE_ID
    ) {
        return;
    }

    if (
        packet.header.msg_type !=
            protocol::MessageType::SET_REQ &&
        packet.header.msg_type !=
            protocol::MessageType::GET_REQ &&
        packet.header.msg_type !=
            protocol::MessageType::DEL_REQ
    ) {
        return;
    }

    protocol::DecodedMessage decoded{};

    if (
        protocol::decode_message(
            packet,
            decoded
        ) != protocol::Result::OK
    ) {
        Serial.println(
            "APPLICATION DECODE: FAIL"
        );
        return;
    }

    request::Identity identity{};

    if (
        request::extract_identity(
            packet,
            identity
        ) != request::PacketResult::OK
    ) {
        Serial.println(
            "REQUEST IDENTITY: FAIL"
        );
        return;
    }

    /*
     * Merge remote HLC before application processing.
     */
    const hlc::Hlc merged_hlc =
        hlc_clock.on_receive(
            packet.header.hlc
        );

    if (merged_hlc == 0) {
        Serial.println(
            "RX HLC MERGE: REJECTED"
        );
        return;
    }

    const std::uint64_t now =
        static_cast<std::uint64_t>(millis());

    const request::DedupResult dedup_result =
        dedup_manager.begin_request(
            identity,
            now
        );

    if (
        dedup_result ==
        request::DedupResult::NEW_REQUEST
    ) {

        Serial.println();
        Serial.println(
            "SERVER: NEW REQUEST"
        );

        kv::OperationResponse operation_response{};

        const kv::Result operation_result =
            kv_engine.execute(
                decoded,
                membership_manager,
                now,
                operation_response
            );

        Serial.print(
            "KV ENGINE RESULT: "
        );

        Serial.println(
            static_cast<unsigned>(
                operation_result
            )
        );

        if (
            packet.header.msg_type ==
            protocol::MessageType::SET_REQ
        ) {
            ++receiver_set_execution_count;

            Serial.print(
                "SET EXECUTION COUNT: "
            );

            Serial.println(
                receiver_set_execution_count
            );
        }

        std::uint8_t response[
            protocol::MAX_PACKET_SIZE
        ]{};

        std::size_t response_length = 0;

        const hlc::Hlc response_hlc =
            hlc_clock.on_local_event();

        if (
            !kv::ResponseBuilder::build(
                packet.header,
                LOCAL_NODE_ID,
                response_hlc,
                operation_response,
                response,
                sizeof(response),
                response_length
            )
        ) {
                        Serial.println(
                "RESPONSE BUILD: FAIL"
            );
            dedup_manager.remove(identity);
            return;
        }

        const request::DedupResult cache_result =
            dedup_manager.complete_request(
                identity,
                response,
                response_length,
                now
            );

        if (
            cache_result !=
            request::DedupResult::NEW_REQUEST
        ) {
            Serial.print(
                "DEDUP CACHE: FAIL ("
            );

            Serial.print(
                static_cast<unsigned>(
                    cache_result
                )
            );

            Serial.println(")");

            return;
        }

        Serial.println(
            "DEDUP CACHE: COMPLETED"
        );

        /*
         * Intentionally lose the first SET_ACK.
         */
        if (
            packet.header.msg_type ==
                protocol::MessageType::SET_REQ &&
            drop_first_set_ack
        ) {
            drop_first_set_ack = false;

            Serial.println(
                "SET_ACK: DELIBERATELY DROPPED"
            );

            return;
        }

        const transport::Result send_result =
            espnow_transport.send_unicast(
                packet.header.origin_node_id,
                response,
                response_length
            );

        if (
            send_result ==
            transport::Result::OK
        ) {
            Serial.println(
                "RESPONSE: SENT"
            );
        } else {
            Serial.print(
                "RESPONSE SEND: FAIL ("
            );

            Serial.print(
                static_cast<unsigned>(
                    send_result
                )
            );

            Serial.println(")");
        }

        return;
    }

    if (
        dedup_result ==
        request::DedupResult::DUPLICATE_IN_PROGRESS
    ) {

        Serial.println(
            "DEDUP: DUPLICATE IN_PROGRESS - SUPPRESSED"
        );

        return;
    }

    if (
        dedup_result ==
        request::DedupResult::DUPLICATE_COMPLETED
    ) {

        Serial.println(
            "DEDUP: DUPLICATE_COMPLETED - REPLAY"
        );

        std::uint8_t cached_response[
            protocol::MAX_PACKET_SIZE
        ]{};

        std::size_t cached_length = 0;

        const request::DedupResult cache_result =
            dedup_manager.get_cached_response(
                identity,
                cached_response,
                sizeof(cached_response),
                cached_length,
                now
            );

        if (
            cache_result !=
            request::DedupResult::DUPLICATE_COMPLETED
        ) {
            Serial.println(
                "DEDUP CACHE READ: FAIL"
            );
            return;
        }

        const transport::Result send_result =
            espnow_transport.send_unicast(
                packet.header.origin_node_id,
                cached_response,
                cached_length
            );

                if (
            send_result ==
            transport::Result::OK
        ) {
            Serial.println(
                "CACHED RESPONSE: REPLAYED"
            );

            Serial.println(
                receiver_set_execution_count == 1
                    ? "EXACTLY-ONCE: PASS"
                    : "EXACTLY-ONCE: FAIL"
            );

            // Re-arm so the next run exercises the retry path again.
            receiver_set_execution_count = 0;
            drop_first_set_ack = true;
        } else {
            Serial.print(
                "CACHED RESPONSE SEND: FAIL ("
            );

            Serial.print(
                static_cast<unsigned>(
                    send_result
                )
            );

            Serial.println(")");
        }

        return;
    }

    Serial.print(
        "DEDUP: UNEXPECTED RESULT ("
    );

    Serial.print(
        static_cast<unsigned>(
            dedup_result
        )
    );

    Serial.println(")");
}

void process_requester_response(
    const transport::ReceivedFrame& frame
)
{
    protocol::PacketView packet{};

    if (
        protocol::deserialize_packet(
            frame.data,
            frame.length,
            packet
        ) != protocol::Result::OK
    ) {
        Serial.println(
            "RESPONSE PACKET DECODE: FAIL"
        );
        return;
    }

    if (
        packet.header.destination_node_id !=
        LOCAL_NODE_ID
    ) {
        return;
    }

    if (
    packet.header.msg_type !=
        protocol::MessageType::SET_ACK &&
    packet.header.msg_type !=
        protocol::MessageType::GET_RESP &&
    packet.header.msg_type !=
        protocol::MessageType::DEL_ACK
) {
    return;
}
    protocol::DecodedMessage decoded{};

    if (
        protocol::decode_message(
            packet,
            decoded
        ) != protocol::Result::OK
    ) {
        Serial.println(
            "OPERATION RESPONSE DECODE: FAIL"
        );
        return;
    }

    const hlc::Hlc merged_hlc =
        hlc_clock.on_receive(
            packet.header.hlc
        );

    if (merged_hlc == 0) {
        Serial.println(
            "ACK HLC MERGE: REJECTED"
        );
        return;
    }

    request::Identity identity{
        packet.header.origin_node_id,
        packet.header.request_id
    };

    if (!identity.valid()) {
        Serial.println(
            "ACK IDENTITY: FAIL"
        );
        return;
    }

    const request::Result completion_result =
        request_manager.complete(
            identity,
            frame.data,
            frame.length
        );

    if (
        completion_result ==
        request::Result::OK
    ) {
        request_finished = true;

        Serial.println();
        Serial.println(
            "REQUEST COMPLETION: PASS"
        );

        return;
    }

    if (
        completion_result ==
            request::Result::UNKNOWN_REQUEST ||
        completion_result ==
            request::Result::ALREADY_TERMINAL
    ) {
        Serial.println(
            "RESPONSE: LATE/UNKNOWN - IGNORED"
        );
        return;
    }

    Serial.print(
        "REQUEST COMPLETION: FAIL ("
    );

    Serial.print(
        static_cast<unsigned>(
            completion_result
        )
    );

    Serial.println(")");
}

void finish_client_operation()
{
    if (
        LOCAL_NODE_ID != node::C ||
        !request_finished ||
        client_test_done
    ) {
        return;
    }

    request_finished = false;

    request::State state{};

    if (
        request_manager.get_state(
            active_request,
            state
        ) != request::Result::OK
    ) {
        Serial.println("FINAL STATE READ: FAIL");
        client_test_done = true;
        return;
    }

    request::RequestInfo info{};

    if (
        request_manager.get_info(
            active_request,
            info
        ) != request::Result::OK
    ) {
        Serial.println("FINAL INFO READ: FAIL");
        client_test_done = true;
        return;
    }

    std::uint8_t response[
        protocol::MAX_PACKET_SIZE
    ]{};

    std::size_t response_length = 0;

    if (
        request_manager.get_completion(
            active_request,
            response,
            sizeof(response),
            response_length
        ) != request::Result::OK
    ) {
        Serial.println("FINAL RESPONSE READ: FAIL");
        client_test_done = true;
        return;
    }

    protocol::PacketView packet{};

    if (
        protocol::deserialize_packet(
            response,
            response_length,
            packet
        ) != protocol::Result::OK
    ) {
        Serial.println("FINAL PACKET DECODE: FAIL");
        request_manager.release(active_request);
        client_test_done = true;
        return;
    }

    protocol::DecodedMessage decoded{};

    if (
        protocol::decode_message(
            packet,
            decoded
        ) != protocol::Result::OK
    ) {
        Serial.println("FINAL MESSAGE DECODE: FAIL");
        request_manager.release(active_request);
        client_test_done = true;
        return;
    }

    bool passed =
        state == request::State::COMPLETED;

    switch (active_operation) {
        case ClientOperation::SET_WITH_RETRY:
            passed =
                passed &&
                packet.header.msg_type ==
                    protocol::MessageType::SET_ACK &&
                decoded.payload.set_ack.status ==
                    protocol::StatusCode::OK &&
                decoded.payload.set_ack.key.len ==
                    test_key_length &&
                std::memcmp(
                    decoded.payload.set_ack.key.data,
                    test_key,
                    test_key_length
                ) == 0 &&
                info.retry_count > 0;

            Serial.println(
                passed
                    ? "WIRE SET + RETRY: PASS"
                    : "WIRE SET + RETRY: FAIL"
            );

            if (passed) {
                Serial.println(
                    "EXACTLY-ONCE: check node A log"
                );
            }
            break;

        case ClientOperation::GET_EXPECT_VALUE:
            passed =
                passed &&
                packet.header.msg_type ==
                    protocol::MessageType::GET_RESP &&
                decoded.payload.get_response.status ==
                    protocol::StatusCode::OK &&
                decoded.payload.get_response.key.len ==
                    test_key_length &&
                std::memcmp(
                    decoded.payload.get_response.key.data,
                    test_key,
                    test_key_length
                ) == 0 &&
                decoded.payload.get_response.value.len ==
                    sizeof(TEST_VALUE) &&
                std::memcmp(
                    decoded.payload.get_response.value.data,
                    TEST_VALUE,
                    sizeof(TEST_VALUE)
                ) == 0;

            Serial.println(
                passed
                    ? "WIRE GET VALUE: PASS"
                    : "WIRE GET VALUE: FAIL"
            );
            break;

        case ClientOperation::DELETE_EXPECT_OK:
            passed =
                passed &&
                packet.header.msg_type ==
                    protocol::MessageType::DEL_ACK &&
                decoded.payload.delete_ack.status ==
                    protocol::StatusCode::OK &&
                decoded.payload.delete_ack.key.len ==
                    test_key_length &&
                std::memcmp(
                    decoded.payload.delete_ack.key.data,
                    test_key,
                    test_key_length
                ) == 0;

            Serial.println(
                passed
                    ? "WIRE DELETE: PASS"
                    : "WIRE DELETE: FAIL"
            );
            break;

        case ClientOperation::GET_EXPECT_NOT_FOUND:
            passed =
                passed &&
                packet.header.msg_type ==
                    protocol::MessageType::GET_RESP &&
                decoded.payload.get_response.status ==
                    protocol::StatusCode::NOT_FOUND &&
                decoded.payload.get_response.key.len ==
                    test_key_length &&
                std::memcmp(
                    decoded.payload.get_response.key.data,
                    test_key,
                    test_key_length
                ) == 0 &&
                decoded.payload.get_response.value.len == 0;

            Serial.println(
                passed
                    ? "WIRE GET NOT_FOUND: PASS"
                    : "WIRE GET NOT_FOUND: FAIL"
            );
            break;
    }

    if (!passed) {
        Serial.println(
            "PHASE 6 WIRE KV TEST: FAIL"
        );

        request_manager.release(active_request);
        client_test_done = true;
        return;
    }

    const ClientOperation completed_operation =
        active_operation;

    if (
        request_manager.release(active_request) !=
        request::Result::OK
    ) {
        Serial.println("REQUEST RELEASE: FAIL");
        Serial.println("PHASE 6 WIRE KV TEST: FAIL");
        client_test_done = true;
        return;
    }

    if (
        completed_operation ==
        ClientOperation::GET_EXPECT_NOT_FOUND
    ) {
        Serial.println();
        Serial.println(
            "SET + GET + DELETE + GET NOT_FOUND: PASS"
        );
        Serial.println(
            "PHASE 6 WIRE KV TEST: PASS"
        );

        client_test_done = true;
        return;
    }

    ClientOperation next_operation =
        ClientOperation::GET_EXPECT_VALUE;

    switch (completed_operation) {
        case ClientOperation::SET_WITH_RETRY:
            next_operation =
                ClientOperation::GET_EXPECT_VALUE;
            break;

        case ClientOperation::GET_EXPECT_VALUE:
            next_operation =
                ClientOperation::DELETE_EXPECT_OK;
            break;

        case ClientOperation::DELETE_EXPECT_OK:
            next_operation =
                ClientOperation::GET_EXPECT_NOT_FOUND;
            break;

        case ClientOperation::GET_EXPECT_NOT_FOUND:
            return;
    }

    if (!start_client_operation(next_operation)) {
        Serial.println(
            "PHASE 6 WIRE KV TEST: FAIL"
        );
    }
}

void start_client_request()
{
    if (
        LOCAL_NODE_ID != node::C ||
        request_started
    ) {
        return;
    }

    request_started = true;

    /*
     * C chooses one key whose current primary is A.
     * Reuse this key for every operation in the test.
     */
    if (!find_key_owned_by_node(node::A)) {
        Serial.println(
            "NO KEY FOUND WITH PRIMARY A"
        );

        Serial.println(
            "PHASE 6 WIRE KV TEST: FAIL"
        );

        client_test_done = true;
        return;
    }

    if (
        !start_client_operation(
            ClientOperation::SET_WITH_RETRY
        )
    ) {
        Serial.println(
            "PHASE 6 WIRE KV TEST: FAIL"
        );
    }
}

void process_incoming()
{
    transport::ReceivedFrame frame{};

    while (
        espnow_transport.receive(
            frame
        )
    ) {
        if (
    LOCAL_NODE_ID == node::A
) {
    process_server_request(
        frame
    );
} else if (
    LOCAL_NODE_ID == node::C
) {
    process_requester_response(
        frame
    );
}
    }
}

bool initialize_system()
{
    Serial.println();
    Serial.println(
        "========================================"
    );
    Serial.println(
        "PHASE 6 - DISTRIBUTED SET INTEGRATION"
    );
    Serial.println(
        "========================================"
    );

    Serial.print(
        "LOCAL NODE: "
    );

    Serial.println(
        static_cast<unsigned>(
            LOCAL_NODE_ID
        )
    );

    /*
     * --------------------------------------------------
     * Persistent storage
     * --------------------------------------------------
     */
    Serial.println(
        "Initializing StorageManager..."
    );

    if (
        storage_manager.begin() !=
        storage::Result::OK
    ) {
        Serial.println(
            "StorageManager: FAIL"
        );
        return false;
    }

    storage::Hlc persisted_hlc = 0;

    if (
        storage_manager.max_persisted_hlc(
            persisted_hlc
        ) != storage::Result::OK
    ) {
        Serial.println(
            "Max persisted HLC: FAIL"
        );
        return false;
    }

    Serial.print(
        "Max persisted HLC: "
    );

    Serial.println(
        static_cast<unsigned long long>(
            persisted_hlc
        )
    );

    /*
     * --------------------------------------------------
     * HLC
     * --------------------------------------------------
     */
    if (
        !hlc_clock.begin(
            persisted_hlc
        )
    ) {
        Serial.println(
            "HLC begin: FAIL"
        );
        return false;
    }

    Serial.println(
        "HLC: READY"
    );

    /*
     * --------------------------------------------------
     * Membership
     *
     * For this integration test we explicitly seed the
     * A/C membership view. Heartbeat itself was already
     * validated in the previous phase.
     * --------------------------------------------------
     */
    if (
        !membership_manager.begin(
            static_cast<std::uint64_t>(millis())
        )
    ) {
        Serial.println(
            "Membership begin: FAIL"
        );
        return false;
    }

    membership_manager.heartbeat_received(
        TEST_PEER_NODE_ID,
        static_cast<std::uint64_t>(millis())
    );

    Serial.println(
        "Membership: LOCAL + PEER ALIVE"
    );

    /*
     * --------------------------------------------------
     * Placement
     * --------------------------------------------------
     */
    if (
        !placement_resolver.begin()
    ) {
        Serial.println(
            "Placement begin: FAIL"
        );
        return false;
    }

    Serial.println(
        "Placement: READY"
    );

    /*
     * --------------------------------------------------
     * KV engine
     * --------------------------------------------------
     */
    if (
        !kv_engine.begin()
    ) {
        Serial.println(
            "KV Engine begin: FAIL"
        );
        return false;
    }

    Serial.println(
        "KV Engine: READY"
    );

    /*
     * --------------------------------------------------
     * ESP-NOW transport
     * --------------------------------------------------
     */
    if (
        espnow_transport.begin(
            LOCAL_NODE_ID
        ) != transport::Result::OK
    ) {
        Serial.println(
            "ESP-NOW transport: FAIL"
        );
        return false;
    }

    Serial.println(
        "ESP-NOW transport: READY"
    );

    /*
     * --------------------------------------------------
     * Reliability / deduplication
     * --------------------------------------------------
     */
    if (
        request_manager.begin() !=
        request::Result::OK
    ) {
        Serial.println(
            "RequestManager: FAIL"
        );
        return false;
    }

    if (
        !dedup_manager.begin()
    ) {
        Serial.println(
            "DedupManager: FAIL"
        );
        return false;
    }

    if (
        !request_id_generator.begin(
            LOCAL_NODE_ID,
            static_cast<std::uint32_t>(
                esp_random()
            )
        )
    ) {
        Serial.println(
            "Request ID Generator: FAIL"
        );
        return false;
    }

    Serial.println(
        "Reliability + Dedup: READY"
    );

    Serial.println();
    Serial.println(
        "SYSTEM READY"
    );

    return true;
}

} // namespace

void setup()
{
    Serial.begin(115200);

    delay(1000);

    system_ready =
        initialize_system();

    if (!system_ready) {
        Serial.println();
        Serial.println(
            "SYSTEM INITIALIZATION FAILED"
        );
        return;
    }

    client_start_time_ms =
        static_cast<std::uint64_t>(millis());
}

void loop()
{
    if (!system_ready) {
        delay(100);
        return;
    }

    const std::uint64_t now =
        static_cast<std::uint64_t>(millis());

    process_incoming();

    dedup_manager.expire(
        now
    );

    request_manager.tick(
        now
    );

    if (
        LOCAL_NODE_ID == node::C &&
        !request_started &&
        now >=
            client_start_time_ms +
            CLIENT_START_DELAY_MS
    ) {
        start_client_request();
    }

    if (
    LOCAL_NODE_ID == node::C &&
    request_finished &&
    !client_test_done
) {
    finish_client_operation();
}

    delay(1);
}